## config/west.yml
```yaml
manifest:
  remotes:
    - name: zmkfirmware
      url-base: https://github.com/zmkfirmware
    - name: ataruno-git
      url-base: https://github.com/ataruno
    - name: caksoylar
      url-base: https://github.com/caksoylar
    - name: prospector  # <-- Prospector Scanner
      url-base: https://github.com/t-ogura  # ★これを追加
  projects:
    - name: zmk
      remote: zmkfirmware
      revision: v0.3-branch
      import: app/west.yml
    - name: zmk-pmw3610-driver_zephyr3
      remote: ataruno-git
      revision: main
    - name: zmk-rgbled-widget
      remote: caksoylar
      revision: main
    - name: prospector-zmk-module
      remote: prospector
      revision: v1.0.0
      path: modules/prospector-zmk-module
  self:
    path: config
```
